## firmware/main/Kconfig.projbuild
```kconfig
menu "Version Configuration"
    config PROJECT_NAME
        string "Project name"
        default "Zhaohui Cat Toilet"

    config PROJECT_VERSION_MAJOR
        int "Major version number"
        default 0

    config PROJECT_VERSION_MINOR
        int "Minor version number"
        default 0

    config PROJECT_VERSION_PATCH
        int "Patch version number"
        default 0

endmenu

menu "Network Configuration"

    config IPV4
        bool "IPV4"
        default y

    config IPV6
        bool "IPV6"
        default n
        select CONNECT_IPV6

    config PORT
        int "Port"
        range 0 65535
        default 3333
        help
            Local port the example server will listen on.

    config KEEPALIVE_IDLE
        int "TCP keep-alive idle time(s)"
        default 5
        help
            Keep-alive idle time. In idle time without receiving any data from peer, will send keep-alive probe packet

    config KEEPALIVE_INTERVAL
        int "TCP keep-alive interval time(s)"
        default 5
        help
            Keep-alive probe packet interval time.

    config KEEPALIVE_COUNT
        int "TCP keep-alive packet retry send counts"
        default 3
        help
            Keep-alive probe packet retry count.

    config WIFI_SSID
        string "WiFi SSID"
        default "myssid"
        help
            SSID (network name) for the example to connect to.

    config WIFI_PASSWORD
        string "WiFi Password"
        default "mypassword"
        help
            WiFi password (WPA or WPA2) for the example to use.
            Can be left blank if the network has no security set.

    config MAXIMUM_CONNECTIONS
        int "Maximum connections"
        default 3
        help
            Set the Maximum number of network connections that have console interface.

    config MAXIMUM_RETRY
        int "Maximum retry"
        default 5
        help
            Set the Maximum retry to avoid station reconnecting to the AP unlimited when the AP is really inexistent.

    config PROVISION_TRANSPORT_BLE
        bool "Use BLE wifi provisioning"
        default y
        help 
            Use BLE as method of wifi provisioning.
    config RESET_PROVISIONED
        bool "Reset previous provisioning(for debug)."
        default n
        help 
            Reset previous provisioning(for debug).
    
    config BLE_REPROVISIONING
        bool "reprovision if provisioning is failed."
        default y 
        help 
            Reprovision if timeout or failure occured.
    
    config PROV_SHOW_QR
        bool "Show QR Code when provisioning"
        default y
    
    config RESET_PROV_MGR_ON_FAILURE
        bool "Reset provisioning manager on failure"
        default y
    config PROV_MGR_MAX_RETRY_CNT
        int "Max retry number of provisioning manager"
        default 5
    endmenu

menu "GPIO pin Configuration"

    config TM1638_STB
        int "TM1638 STB GPIO pin"
        default 5
        help
            GPIO pin number connected to TM1638 STB

    config TM1638_CLK
        int "TM1638 CLK GPIO pin"
        default 18
        help
            GPIO pin number connected to TM1638 CLK

    config TM1638_DIO
        int "TM1638 DIO GPIO pin"
        default 23
        help
            GPIO pin number connected to TM1638 DIO

    config DRV8871_A
        int "burshed motor driver PWM pin A"
        default 32
        help
            PWM GPIO pin number connected to DRV8871_A

    config DRV8871_B
        int "burshed motor driver PWM pin B"
        default 33
        help
            PWM GPIO pin number connected to DRV8871_B

    config HX711_SCK
        int "HX711 weight sensor ADC SCK"
        default 16
        help
            GPIO pin number connected to HX711 SCK

    config HX711_DT
        int "HX711 weight sensor ADC DT"
        default 17
        help
            GPIO pin number connected to HX711 DT

    config ADC1_IN
        int "motor current ADC"
        default 35
        help
            ADC1 GPIO pin number connected to motor current feedback

    config RESET_BTN
        int "soft reset button for clearing config"
        default 27
        help
            GPIO pin number for soft reset, hold for 3s to clear wifi connection config and other data

    config BUTTON0
        int "gpio for limit switch 0"
        default 2
        help
            GPIO pin number connected to limit switch 0

    config BUTTON1
        int "gpio for limit switch 1"
        default 4
        help
            GPIO pin number connected to limit switch 1

    config BUTTON2
        int "gpio for infrared sensor 0"
        default 25
        help
            GPIO pin number connected to infrared sensor 0

    config BUTTON3
        int "gpio for infrared sensor 1"
        default 26
        help
            GPIO pin number connected to infrared sensor 1

endmenu
```
